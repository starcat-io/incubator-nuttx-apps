## examples/partition/Kconfig
```kconfig
#
# For a description of the syntax of this configuration file,
# see the file kconfig-language.txt in the NuttX tools repository.
#

config EXAMPLES_PARTITION
	tristate "Partition table dump"
	default n
	---help---
	Simple program to dump partition table of /dev/sda
```
